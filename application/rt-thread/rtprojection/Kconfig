## application/rt-thread/rtprojection/Kconfig
```kconfig
# SPDX-License-Identifier: GPL-3.0-only
source "application/rt-thread/rtprojection/backends/androidauto/Kconfig"
config RTPROJECTION_DEMO
    bool
    default y
    select LV_FONT_MONTSERRAT_14
    select LV_FONT_MONTSERRAT_16
    select LV_FONT_MONTSERRAT_24
    select LV_FONT_MONTSERRAT_32
    depends on LPKG_USING_LVGL && LVGL_V_9 && (RTANDROIDAUTO_USB || RTANDROIDAUTO_WIRELESS)
    depends on !RT_USING_MODULE && !RTANDROIDAUTO_AUTO_START
```

## application/rt-thread/rtprojection/backends/androidauto/Kconfig
```kconfig
# SPDX-License-Identifier: GPL-3.0-only
source "packages/third-party/rt-androidauto/Kconfig"

menu "Android Auto backend"
config RTANDROIDAUTO_USB
    bool "CherryUSB AOA transport on the dedicated phone host port"
    default y
    depends on LPKG_USING_RT_ANDROIDAUTO && LPKG_CHERRYUSB_HOST

config RTANDROIDAUTO_CREDENTIAL_DIR
    string "Provisioned TLS identity and peer pin directory"
    default "/data/androidauto"
    help
      Requires client.pem, client.key and peer.sha256 (32 raw bytes).
      No default identity, test key or trust-all policy is installed.

config RTANDROIDAUTO_USB_BUS
    int "CherryUSB bus for the dedicated Android phone connector"
    default 1 if AIC_USING_USB0_HOST
    default 0
    range 0 1
    depends on RTANDROIDAUTO_USB
    help
      USB1 is bus 0 when USB0 is not a host, and bus 1 when both are hosts.
      The AOA adapter never sends vendor requests to another host bus.

config RTANDROIDAUTO_AUTO_START
    bool "Arm wired receiver automatically at boot"
    default n
    depends on RTANDROIDAUTO_USB

config RTANDROIDAUTO_VIDEO
    bool "MPP H.264 decoder and DE video output"
    default y
    depends on RTANDROIDAUTO_USB && AIC_MPP_H264_DEC_ENABLE

config RTANDROIDAUTO_AUDIO
    bool "Media/System/Speech PCM playback through sound0"
    default y
    depends on RTANDROIDAUTO_USB && RT_USING_AUDIO
endmenu
```

## bsp/peripheral/wireless/aic8800/Kconfig.dev
```kconfig
#-----------------------------
# aic8800 wlan devices local parameter
#-----------------------------

# wlan0 parameter

menu "Wlan0 Parameter"

    config CHIP_SELECT_AIC8800D40
        def_bool AIC_WLAN_AIC8800D40

    choice
        prompt "Select AIC8800 MODEL"
        depends on AIC_WLAN_AIC8800D40L
        default CHIP_SELECT_AIC8800D40L
        config CHIP_SELECT_AIC8800D40L
            bool "select AIC8800D40L"
        config CHIP_SELECT_AIC8800DW
            bool "select AIC8800DW"
        config CHIP_SELECT_AIC8800DL
            bool "select AIC8800DL"
        config CHIP_SELECT_AIC8800M40B
            bool "select AIC8800M40B"
    endchoice

    choice
        prompt "Select AIC8800 power converter"
        default CONFIG_AIC8800_VRF_DCDC_MODE
        config CONFIG_AIC8800_VRF_DCDC_MODE
            bool "select DCDC mode"
        config CONFIG_AIC8800_VRF_LDO_MODE
            bool "select LDO mode"
    endchoice

    choice
        prompt "Select AIC8800 work mode"
        default CONFIG_AIC8800_NORMAL_MODE
        config CONFIG_AIC8800_NORMAL_MODE
            bool "select normal mode"
        config CONFIG_AIC8800_RFTEST_MODE
            bool "select rftest mode"
        config CONFIG_AIC8800_FTTEST_MODE
            bool "select fttest mode"
    endchoice

    config CONFIG_AIC8800_MAC_USE_CHIP_ID
        bool "enable aic8800 mac use chip id"
        default n
        select AIC_USING_SID
        select AIC_MAC_CHIPID_DRV

    config CONFIG_AIC8800_BT_SUPPORT
        bool "enable aic8800 BT support"
        default n

    config AIC8800_AP_VENDOR_IE
        bool "Set optional vendor elements before AIC8800 SoftAP starts"
        depends on CHIP_SELECT_AIC8800D40 || CHIP_SELECT_AIC8800D40L
        default n

    config AIC_DEV_AIC8800_DEBUG_LOG
        bool "enable aic8800 debug messages"
        default y

    config AIC_WIRELESS_DELAY_POWER_ON
        int "wireless delay power on time (seconds)"
        default 0

endmenu
```

## packages/third-party/cherryusb-ipheth-luban/Kconfig
```kconfig
# SPDX-License-Identifier: Apache-2.0
config LPKG_USING_CHERRYUSB_IPHETH
    bool "Apple iPhone USB Ethernet external CherryUSB host class"
    depends on LPKG_CHERRYUSB_HOST && RT_USING_LWIP
    default n
    help
      Independent IPHETH Ethernet driver. Does not select a USB configuration
      or initialize controllers; USBMUX and the application own those policies.

config LPKG_CHERRYUSB_IPHETH_PATH
    string "cherryusb-ipheth repository path (relative to SDK root)"
    depends on LPKG_USING_CHERRYUSB_IPHETH
    default "packages/third-party/cherryusb-ipheth"
    help
      Path to the cherryusb-ipheth checkout.  The SDK default points at the
      bundled git submodule.  An absolute path or a path outside the SDK can
      be used to build against a separate checkout.
```

## target/configs/d21x_demo128-nand-carplay_rt-thread_helloworld_rt-aic8800_defconfig
```kconfig
CONFIG_PRJ_DEFCONFIG_FILENAME="d21x_demo128-nand-carplay_rt-thread_helloworld_rt-aic8800_defconfig"
CONFIG_PRJ_CHIP="d21x"
CONFIG_PRJ_BOARD="demo128-nand-carplay"
CONFIG_PRJ_KERNEL="rt-thread"
CONFIG_PRJ_APP="helloworld"
CONFIG_PRJ_IMAGE_VARIANT="rt-aic8800"
CONFIG_AIC_USING_UART0=y
CONFIG_AIC_USING_QSPI0=y
CONFIG_AIC_QSPI0_DEVICE_SPINAND=y
CONFIG_AIC_NFTL_SUPPORT=y
CONFIG_AIC_NFLT_USED_LIB=y
CONFIG_AIC_USING_SDMC2=y
CONFIG_AIC_SDMC2_IS_SDIO=y
CONFIG_AIC_SDMC2_BUSWIDTH4=y
CONFIG_AIC_SDMC2_CLK_FREQ=40000000
CONFIG_AIC_WIRELESS_LAN=y
CONFIG_AIC_WIFI_SDMC_ID=2
CONFIG_AIC_WIRELESS_PWR_GPIO="PD.1"
CONFIG_AIC_WIRELESS_BT_PWR_GPIO="PD.3"
CONFIG_AIC_WLAN_AIC8800D40=y
CONFIG_AIC8800_BACKEND_OPEN=y
CONFIG_AIC_DRAM_CMA_SIZE=0x2000000
CONFIG_RT_MEMHEAP_BSET_MODE=y
CONFIG_RT_USING_MEMHEAP_AS_HEAP=y
CONFIG_RT_CONSOLE_DEVICE_NAME="uart0"
CONFIG_RT_USING_FINSH=y
CONFIG_RT_USING_MSH=y
CONFIG_FINSH_USING_MSH=y
CONFIG_RT_MMCSD_STACK_SIZE=8192
```
